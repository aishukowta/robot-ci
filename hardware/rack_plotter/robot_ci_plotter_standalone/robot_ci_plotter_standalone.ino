/*
  Robot CI rack plotter - STANDALONE sketch (no Python / no laptop software needed)
  -----------------------------------------------------------------------------------
  The Robot CI pen plans are stored inside this sketch. Upload it with the Arduino IDE, open the
  Serial Monitor (115200 baud, line ending "Newline"), calibrate once, then type  R 1  to draw plan 1.

  Wiring (each 28BYJ-48 stays plugged into its ULN2003 board):
    X   board IN1..IN4 -> D2  D3  D4  D5     (pen left/right)
    Y   board IN1..IN4 -> D6  D7  D8  D9     (pen towards/away)
    PEN board IN1..IN4 -> D10 D11 D12 D13    (pen up/down)
    all boards: "-" -> GND,  "+" -> 5 V (separate 5 V 2 A supply recommended; join its GND to Arduino GND)

  Serial Monitor commands:
    L            list the stored plans                 R n      draw plan n (5 s countdown first)
    T            axis test: 40 mm line to the RIGHT of the page, then 20 mm DOWN the page
    J X d / J Y d   jog the pen d mm                   J Z n    turn the pen motor n steps
    Q            current pen-motor position = pen UP   P n      pen DOWN = n steps below pen up
    U / D        pen up / pen down                     H        current pen position = HOME
    S sx sy      steps per mm for X and Y              I ix iy  invert X / Y (0 or 1)
    X s          swap X and Y (0 or 1)                 F d t    draw / travel speed in mm/s
    C            show settings                         W        save settings (kept after power-off)
    M            switch all motors off                 ?        where am I
*/

#include <Arduino.h>
#include <EEPROM.h>
#include <avr/pgmspace.h>
#include <stdlib.h>
#include <string.h>

// ------------------------------------------------------------------ pins
const uint8_t PINS[3][4] = {{ 2,  3,  4,  5},     // X
                            { 6,  7,  8,  9},     // Y
                            {10, 11, 12, 13}};    // PEN
const uint8_t SEQ[8][4] = {{1,0,0,0},{1,1,0,0},{0,1,0,0},{0,1,1,0},
                           {0,0,1,0},{0,0,1,1},{0,0,0,1},{1,0,0,1}};

// ------------------------------------------------------------------ settings (defaults; change with S/P/I/X/F, save with W)
struct Settings {
  uint16_t magic;
  float spmmX, spmmY;          // half-steps per mm
  uint8_t invX, invY, swapXY;
  float homeX, homeY;          // page mm where the pen sits before a run (measure with a ruler)
  float wsX0, wsX1, wsY0, wsY1;// safe travel from home: right (X) and down the page (Y), in mm
  long  penDown;               // pen-motor steps from up to touching the paper
  float drawFeed, travelFeed;  // mm/s
  uint16_t minUs;              // fastest half-step interval
};
Settings st = {0xC1A5, 130.0, 130.0, 0, 0, 0, 55.0, 55.0, 0.0, 90.0, 0.0, 75.0, 300, 5.0, 6.0, 1200};

// ------------------------------------------------------------------ plans (generated from Robot CI plan.json files)
struct Wp { int16_t x, y; uint8_t pen; };     // page coordinates in 0.01 mm, pen 1 = down

// plan 1: word_hello / writing_baseline  hash 4b69978ebb27afd1
const Wp PLAN1[] PROGMEM = {
  {1000,1000,0},
  {6000,6000,0},
  {6000,6100,1},
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  {1000,1000,0}
};

// plan 2: word_hello / writing_candidate  hash 9b7a63446cfded6b
const Wp PLAN2[] PROGMEM = {
  {1000,1000,0},
  {6071,6044,0},
  {6077,6143,1},
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  {1000,1000,0}
};

// plan 3: pattern_square / writing_baseline  hash f9d9e3adaa619f3e
const Wp PLAN3[] PROGMEM = {
  {1000,1000,0},
  {7500,6000,0},
  {7600,6000,1},
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  {1000,1000,0}
};

// plan 4: pattern_square / writing_candidate  hash 2ab05ca5e98d11c6
const Wp PLAN4[] PROGMEM = {
  {1000,1000,0},
  {9042,6070,0},
  {9132,6056,1},
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  {1000,1000,0}
};

struct PlanRef { const Wp *pts; uint16_t n; };
const PlanRef PLANS[4] = {
  {PLAN1, 241},
  {PLAN2, 261},
  {PLAN3, 244},
  {PLAN4, 212}
};
const char *PLAN_NAMES[4] = {
  "1: word_hello / writing_baseline (hash 4b69978ebb27afd1)",
  "2: word_hello / writing_candidate (hash 9b7a63446cfded6b)",
  "3: pattern_square / writing_baseline (hash f9d9e3adaa619f3e)",
  "4: pattern_square / writing_candidate (hash 2ab05ca5e98d11c6)"
};
const uint8_t NPLANS = 4;

// ------------------------------------------------------------------ motion
long pos[3] = {0, 0, 0};
int8_t phase[3] = {0, 0, 0};

void energize(uint8_t m) { for (uint8_t i = 0; i < 4; i++) digitalWrite(PINS[m][i], SEQ[phase[m]][i]); }
void releaseMotor(uint8_t m) { for (uint8_t i = 0; i < 4; i++) digitalWrite(PINS[m][i], LOW); }
void stepOnce(uint8_t m, int8_t d) { phase[m] = (phase[m] + d + 8) & 7; energize(m); pos[m] += d; }
void waitUntil(unsigned long &t, unsigned long us) { t += us; while ((long)(micros() - t) < 0) { } }

void moveXY(long tx, long ty, float feed) {
  long dx = tx - pos[0], dy = ty - pos[1], ax = labs(dx), ay = labs(dy), n = max(ax, ay);
  if (n == 0) return;
  int8_t sx = dx > 0 ? 1 : -1, sy = dy > 0 ? 1 : -1;
  float lenMm = sqrt(sq(dx / st.spmmX) + sq(dy / st.spmmY));
  unsigned long us = st.minUs;
  if (feed > 0) { float u = lenMm / feed * 1e6 / n; if (u > st.minUs) us = (unsigned long)u; }
  energize(0); energize(1);
  long ex = n / 2, ey = n / 2;
  unsigned long t = micros();
  for (long i = 0; i < n; i++) {
    ex -= ax; if (ex < 0) { ex += n; stepOnce(0, sx); }
    ey -= ay; if (ey < 0) { ey += n; stepOnce(1, sy); }
    waitUntil(t, us);
  }
  releaseMotor(0); releaseMotor(1);       // the 64:1 gearbox holds position
}
void moveMm(float x, float y, float feed) { moveXY(lround(x * st.spmmX), lround(y * st.spmmY), feed); }

void movePen(long target) {
  long d = target - pos[2];
  if (d == 0) return;
  int8_t s = d > 0 ? 1 : -1;
  energize(2);
  unsigned long t = micros();
  for (long i = 0; i < labs(d); i++) { stepOnce(2, s); waitUntil(t, 1500); }
  releaseMotor(2);
  delay(150);
}
void penUp() { movePen(0); }
void penDn() { movePen(st.penDown); }

// page mm -> offset from home in PAGE directions (dx to the right, dy down the page)
void pageRel(float px, float py, float &dx, float &dy) { dx = px - st.homeX; dy = py - st.homeY; }
// page-direction offset -> machine axes (apply swap / invert found with the axis test)
void toMachine(float dx, float dy, float &mx, float &my) {
  if (st.swapXY) { float t = dx; dx = dy; dy = t; }
  if (st.invX) dx = -dx;
  if (st.invY) dy = -dy;
  mx = dx; my = dy;
}
// workspace = how far the pen may go to the RIGHT (wsX) and DOWN the page (wsY) from home
bool inside(float dx, float dy) { return dx >= st.wsX0 - 1e-3 && dx <= st.wsX1 + 1e-3 && dy >= st.wsY0 - 1e-3 && dy <= st.wsY1 + 1e-3; }

Wp readWp(const Wp *p, uint16_t i) {
  Wp w;
  w.x = (int16_t)pgm_read_word(&p[i].x); w.y = (int16_t)pgm_read_word(&p[i].y); w.pen = pgm_read_byte(&p[i].pen);
  return w;
}

bool stopRequested() {
  if (Serial.available()) { while (Serial.available()) Serial.read(); return true; }   // any key aborts
  return false;
}

void runPlan(uint8_t k) {
  const PlanRef &pl = PLANS[k];
  // 1) check that every pen-down point fits the workspace
  uint16_t bad = 0;
  for (uint16_t i = 0; i < pl.n; i++) {
    Wp w = readWp(pl.pts, i); float dx, dy;
    pageRel(w.x / 100.0, w.y / 100.0, dx, dy);
    if (w.pen && !inside(dx, dy)) bad++;
  }
  if (bad) {
    Serial.print(F("STOP: ")); Serial.print(bad);
    Serial.println(F(" pen-down points are outside the workspace. Check home (homeX/homeY), invert/swap and workspace."));
    return;
  }
  Serial.print(F("Plan ")); Serial.println(PLAN_NAMES[k]);
  Serial.println(F("Pen must be UP at the HOME point. START THE VIDEO NOW. Starting in 5 s (type any key to abort)."));
  for (int s = 5; s > 0; s--) { Serial.println(s); delay(1000); }
  while (Serial.available()) Serial.read();
  pos[0] = 0; pos[1] = 0;                // current position = home
  penUp();
  Serial.println(F("START"));
  unsigned long t0 = millis();
  bool down = false;
  for (uint16_t i = 0; i < pl.n; i++) {
    Wp w = readWp(pl.pts, i); float dx, dy, mx, my;
    pageRel(w.x / 100.0, w.y / 100.0, dx, dy);
    if (!w.pen) {                        // pen-up travel may be clamped safely
      dx = constrain(dx, st.wsX0, st.wsX1); dy = constrain(dy, st.wsY0, st.wsY1);
    }
    toMachine(dx, dy, mx, my);
    if (w.pen && !down) { penDn(); down = true; }
    if (!w.pen && down) { penUp(); down = false; }
    moveMm(mx, my, w.pen ? st.drawFeed : st.travelFeed);
    if (stopRequested()) { penUp(); Serial.println(F("ABORTED")); return; }
  }
  penUp();
  moveMm(0, 0, st.travelFeed);
  Serial.print(F("DONE in ")); Serial.print((millis() - t0) / 1000.0, 1);
  Serial.println(F(" s. Keep filming 2 more seconds, then stop the video."));
}

void axisTest() {
  Serial.println(F("Axis test: long line must go RIGHT on the page, short line must go DOWN the page."));
  pos[0] = 0; pos[1] = 0;
  float mx, my;
  penUp();
  toMachine(40, 0, mx, my); penDn(); moveMm(mx, my, st.drawFeed); penUp();
  moveMm(0, 0, st.travelFeed);
  toMachine(0, 20, mx, my); penDn(); moveMm(mx, my, st.drawFeed); penUp();
  moveMm(0, 0, st.travelFeed);
}

void showSettings() {
  Serial.print(F("steps/mm X Y: ")); Serial.print(st.spmmX, 2); Serial.print(' '); Serial.println(st.spmmY, 2);
  Serial.print(F("invert X Y: ")); Serial.print(st.invX); Serial.print(' '); Serial.print(st.invY);
  Serial.print(F("   swapXY: ")); Serial.println(st.swapXY);
  Serial.print(F("home on page (mm): ")); Serial.print(st.homeX, 1); Serial.print(' '); Serial.println(st.homeY, 1);
  Serial.print(F("workspace X: ")); Serial.print(st.wsX0, 1); Serial.print(F("..")); Serial.print(st.wsX1, 1);
  Serial.print(F("  Y: ")); Serial.print(st.wsY0, 1); Serial.print(F("..")); Serial.println(st.wsY1, 1);
  Serial.print(F("pen down steps: ")); Serial.println(st.penDown);
  Serial.print(F("speed draw/travel mm/s: ")); Serial.print(st.drawFeed, 1); Serial.print(' '); Serial.println(st.travelFeed, 1);
}

// ------------------------------------------------------------------ commands
char buf[48]; uint8_t len = 0;
float arg(bool &ok) { char *t = strtok(NULL, " \t"); if (!t) { ok = false; return 0; } return atof(t); }

void handle(char *line) {
  char *cmd = strtok(line, " \t");
  if (!cmd) return;
  bool ok = true;
  switch (toupper(cmd[0])) {
    case 'L': for (uint8_t i = 0; i < NPLANS; i++) Serial.println(PLAN_NAMES[i]); break;
    case 'R': { int k = (int)arg(ok); if (ok && k >= 1 && k <= NPLANS) runPlan(k - 1); else Serial.println(F("usage: R 1..N")); return; }
    case 'T': axisTest(); break;
    case 'J': {
      char *ax = strtok(NULL, " \t"); float v = arg(ok);
      if (!ax || !ok) { Serial.println(F("usage: J X|Y|Z value")); return; }
      char a = toupper(ax[0]);
      if (a == 'X') moveXY(pos[0] + lround(v * st.spmmX), pos[1], 0);
      else if (a == 'Y') moveXY(pos[0], pos[1] + lround(v * st.spmmY), 0);
      else if (a == 'Z') movePen(pos[2] + (long)v);
      break; }
    case 'Q': pos[2] = 0; break;
    case 'P': { float v = arg(ok); if (ok) st.penDown = (long)v; break; }
    case 'U': penUp(); break;
    case 'D': penDn(); break;
    case 'H': pos[0] = 0; pos[1] = 0; break;
    case 'S': { float a = arg(ok), b = arg(ok); if (ok && a > 0 && b > 0) { st.spmmX = a; st.spmmY = b; } break; }
    case 'I': { float a = arg(ok), b = arg(ok); if (ok) { st.invX = a > 0.5; st.invY = b > 0.5; } break; }
    case 'X': { float a = arg(ok); if (ok) st.swapXY = a > 0.5; break; }
    case 'F': { float a = arg(ok), b = arg(ok); if (ok && a > 0 && b > 0) { st.drawFeed = a; st.travelFeed = b; } break; }
    case 'C': showSettings(); return;
    case 'W': EEPROM.put(0, st); Serial.println(F("saved")); return;
    case 'M': for (uint8_t m = 0; m < 3; m++) releaseMotor(m); break;
    case '?':
      Serial.print(F("pos mm ")); Serial.print(pos[0] / st.spmmX, 2); Serial.print(' ');
      Serial.print(pos[1] / st.spmmY, 2); Serial.print(F("  pen steps ")); Serial.println(pos[2]);
      return;
    default: Serial.println(F("unknown command (see list at top of the sketch)")); return;
  }
  Serial.println(ok ? F("ok") : F("missing value"));
}

void setup() {
  for (uint8_t m = 0; m < 3; m++) for (uint8_t i = 0; i < 4; i++) { pinMode(PINS[m][i], OUTPUT); digitalWrite(PINS[m][i], LOW); }
  Serial.begin(115200);
  Settings saved; EEPROM.get(0, saved);
  if (saved.magic == 0xC1A5) st = saved;
  Serial.println(F("Robot CI rack plotter (standalone). Type C for settings, L for plans, R 1 to draw plan 1."));
}

void loop() {
  while (Serial.available()) {
    char c = Serial.read();
    if (c == '\r') continue;
    if (c == '\n') { buf[len] = 0; handle(buf); len = 0; }
    else if (len < sizeof(buf) - 1) buf[len++] = c;
  }
}
